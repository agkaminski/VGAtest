#include <stdint.h>

#include <avr/io.h>
#include <util/delay.h>
#include <avr/pgmspace.h>


static const uint16_t string[] PROGMEM = {
	0x6f4d, 0x206a, 0x7473, 0x7261, 0x2079, 0x6f74, 0x6620, 0x6e61, 
	0x7461, 0x6b79, 0x7720, 0x6465, 0x616b, 0x7372, 0x7774, 0x2e61, 
	0x5020, 0x6c6f, 0x6d20, 0x6569, 0x7a73, 0x616b, 0x696e, 0x2061, 
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	0x696e, 0x6e65, 0x7761, 0x6469, 0x697a, 0x2e6c, 0x000a
};


static char getChar(size_t pos)
{
	uint16_t data = pgm_read_word(string + (pos / 2));
	return (pos & 1) ? data >> 8 : data & 0xff;
}


static void setAddr(uint16_t addr)
{
	PORTC = addr & 0xff;
	uint8_t temp = PORTD & ~0x1f;
	PORTD = temp | ((addr >> 8) & 0x1f);
}

static void setData(uint8_t data)
{
	PORTA = data;
}

static void selectROM(int sel)
{
	uint8_t temp = PORTD & ~(0x3 << 6);
	PORTD = temp | ((sel & 0x3) << 6);
}

static void writeByte(uint16_t addr, uint8_t data)
{
	setAddr(addr);
	setData(data);

	PORTB &= ~((1 << 2) | 1);

	_delay_us(100);

	PORTB |= (1 << 2) | 1;
}

static void putChar(int row, int col, char c)
{
	uint16_t addr = (row << 7) + col;
	writeByte(addr, c);
}

static void vsync(void)
{
	while (PINB & (1 << 4));
	while (!(PINB & (1 << 4)));
}

static void clear(void)
{
	for (uint16_t addr = 0; addr < 8192; addr++)
		writeByte(addr, ' ');
}

int main(void)
{
	/* Inactivate control signals */
	DDRB = 0x0f;
	PORTB = 0xff;

	/* Address bus */
	DDRC = 0xff;
	DDRD = 0xff;

	/* Data bus */
	DDRA = 0xff;

	/* Select ROM #0 */
	selectROM(0);

	/* Reset chipset */
	PORTB &= ~(1 << 3);

	/* Clear memory */
	clear();

	/* Release the kraken! */
	PORTB |= 1 << 3;

	int rom = 0;

	while (1) {
		char c;
		int pos = 0;
		int row = 0, col = 0;
		while ((c = getChar(pos++)) != '\0') {
			if (c == '\n') { row++; col = 0; continue; }

			/* Wait for vsync */
			vsync();

			putChar(row, col, c);
			if (++col >= 80) { col = 0; ++row; }
		}

		for (int i = 0; i < 8; ++i)
			_delay_ms(250);

		clear();

		if (++rom > 1) rom = 0;
		selectROM(rom);
	}

	return 0;
}

